/**
 * These arguments were used when this file was generated. They will be automatically applied on subsequent loads
 * via the GUI or CLI. Run CLI with '--help' for additional information on how to override these arguments.
 * @cliArgs --device "F28004x" --part "F28004x_64PM" --package "F28004x_64PM" --context "system" --product "C2000WARE@5.04.00.00"
 * @v2CliArgs --device "TMS320F280049C" --package "64PM" --context "system" --product "C2000WARE@5.04.00.00"
 * @versions {"tool":"1.22.0+3893"}
 */
